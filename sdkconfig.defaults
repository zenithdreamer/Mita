## sdkconfig.defaults
```kconfig
# ESP-IDF Configuration for Mita Project
CONFIG_AUTOSTART_ARDUINO=y

# CONFIG_WS2812_LED_ENABLE is not set

# Enable Bluetooth
CONFIG_BT_ENABLED=y
CONFIG_BT_NIMBLE_ENABLED=y
CONFIG_BTDM_CTRL_MODE_BLE_ONLY=y

# NimBLE Configuration
CONFIG_ESPTOOLPY_FLASHSIZE_4MB=y

# mbedTLS PSK
CONFIG_MBEDTLS_PSK_MODES=y
CONFIG_MBEDTLS_KEY_EXCHANGE_PSK=y

# FreeRTOS
CONFIG_FREERTOS_HZ=1000
CONFIG_BT_NIMBLE_ROLE_CENTRAL=y
CONFIG_BT_NIMBLE_ROLE_PERIPHERAL=n
CONFIG_BT_NIMBLE_ROLE_BROADCASTER=n
CONFIG_BT_NIMBLE_ROLE_OBSERVER=y
CONFIG_BT_NIMBLE_MAX_BONDS=3
CONFIG_BT_NIMBLE_MAX_CCCDS=8

# L2CAP CoC Configuration
CONFIG_BT_NIMBLE_L2CAP_COC_MAX_NUM=4
CONFIG_BT_NIMBLE_L2CAP_COC_CHAN_MAX=4
CONFIG_BT_NIMBLE_L2CAP_COC_SDU_BUFF_COUNT=4

# WiFi Configuration
CONFIG_ESP32_WIFI_STATIC_RX_BUFFER_NUM=10
CONFIG_ESP32_WIFI_DYNAMIC_RX_BUFFER_NUM=32
CONFIG_ESP32_WIFI_STATIC_TX_BUFFER=y
CONFIG_ESP32_WIFI_TX_BUFFER_TYPE=1
CONFIG_ESP32_WIFI_STATIC_TX_BUFFER_NUM=16
CONFIG_ESP32_WIFI_AMPDU_TX_ENABLED=y
CONFIG_ESP32_WIFI_AMPDU_RX_ENABLED=y
CONFIG_ESP32_WIFI_ENABLE_WPA3_SAE=y

# Compiler options
CONFIG_COMPILER_CXX_EXCEPTIONS=y
CONFIG_COMPILER_CXX_RTTI=y

# FreeRTOS
CONFIG_FREERTOS_HZ=1000
CONFIG_ESP_TIMER_TASK_STACK_SIZE=4096

# LWIP
CONFIG_LWIP_MAX_SOCKETS=16
CONFIG_LWIP_RAW=y
CONFIG_LWIP_NETIF_LOOPBACK=y
CONFIG_LWIP_SO_REUSE=y
CONFIG_LWIP_SO_RCVBUF=y
CONFIG_LWIP_IP_FORWARD=y
CONFIG_LWIP_IPV4=y

# Main task stack size
CONFIG_ESP_MAIN_TASK_STACK_SIZE=8192

# NVS
CONFIG_NVS_ENCRYPTION=n

# Partition Table
CONFIG_PARTITION_TABLE_CUSTOM=y
CONFIG_PARTITION_TABLE_CUSTOM_FILENAME="partitions.csv"
CONFIG_PARTITION_TABLE_FILENAME="partitions.csv"

# mbedTLS
CONFIG_MBEDTLS_HARDWARE_AES=y
CONFIG_MBEDTLS_HARDWARE_SHA=y
```
